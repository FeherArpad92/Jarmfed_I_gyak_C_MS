/******************************************************************************
 * Created: 
 * Author :
******************************************************************************/
 /******************************************************************************
* Include files
******************************************************************************/
#include <avr/io.h>
#include <inttypes.h>

/******************************************************************************
* Macros
******************************************************************************/


/******************************************************************************
* Constants
******************************************************************************/


/******************************************************************************
* Global Variables
******************************************************************************/
uint16_t timer_cnt=0;
uint8_t timer_task_10ms=0, timer_task_100ms=0, timer_task_500ms=0, timer_task_1s=0;

/******************************************************************************
* External Variables
******************************************************************************/


/******************************************************************************
* Local Function Declarations
******************************************************************************/
void port_init(void);
void timer_init(void);
uint8_t check_timer_compare(void);
/******************************************************************************
* Local Function Definitions
******************************************************************************/

/*****************************************************************************
* Function:         void port_init(void)
* Description:      I/O portok inicializálása
* Input:
* Output:
* Notes:
******************************************************************************/
void port_init(void)
{
	DDRA = (1<<PA3) | (1<<PA2) | (1<<PA1) | (1<<PA0);
	PORTA = (1<<PA3) | (1<<PA2) | (1<<PA1) | (1<<PA0);
	
	DDRB = (0<<PB0) | (0<<PB1);
	PORTB = (1<<PB0) | (1<<PB1);
}

/******************************************************************************
* Function:         void timer_init(void)
* Description:      Timer 0 inicializálása
* Input:
* Output:
* Notes:
******************************************************************************/
void timer_init(void)
{
	TCCR0 = (0<<WGM00) | (1<<WGM01) | (1<<CS02) | (1<<CS01) | (1<<CS00);
	OCR0 = 77;
}

/******************************************************************************
* Function:         uint8_t check_timer_compare(void)
* Description:      Timer jelzés kiolvasása
* Input:
* Output:			1, ha a timer jelez, 0 ha nem
* Notes:
******************************************************************************/
uint8_t check_timer_compare(void)
{
	if((TIFR & (1<<OCF0)) == (1<<OCF0))
	{
		TIFR = TIFR | (1<<OCF0);
		return 1;
	}
	return 0;
}

/******************************************************************************
* Function:         int main(void)
* Description:      main function
* Input:            
* Output:           
* Notes:            
******************************************************************************/
int main(void)
{
	port_init();
	timer_init();
	
	//Végtelen ciklus
	while(1)
	{
		if(check_timer_compare())
		{
			timer_cnt++;
			if((timer_cnt % 1) == 0) timer_task_10ms=1;
			if((timer_cnt % 10) == 0) timer_task_100ms=1;
			if((timer_cnt % 50) == 0) timer_task_500ms=1;
			if((timer_cnt % 100) == 0) timer_task_1s=1;
			
			//PORTA = PORTA ^ (1<<PA0);
		}
		
		if(timer_task_10ms)
		{
			PORTA ^= (1<<PA0);
			timer_task_10ms =0;
		}
		
		if(timer_task_100ms)
		{
			PORTA ^= (1<<PA1);
			timer_task_100ms =0;
		}
		
		if(timer_task_500ms)
		{
			PORTA ^= (1<<PA2);
			timer_task_500ms=0;
		}
		
		if(timer_task_1s)
		{
			PORTA ^= (1<<PA3);
			timer_task_1s=0;
		}

	}
}
/******************************************************************************
* Interrupt Routines
******************************************************************************/