/******************************************************************************
 * Created: 
 * Author :
******************************************************************************/
 /******************************************************************************
* Include files
******************************************************************************/
#include <avr/io.h>
#define F_CPU 8000000UL
#include <avr/delay.h>


/******************************************************************************
* Macros
******************************************************************************/


/******************************************************************************
* Constants
******************************************************************************/


/******************************************************************************
* Global Variables
******************************************************************************/
int irany=0;

/******************************************************************************
* External Variables
******************************************************************************/


/******************************************************************************
* Local Function Declarations
******************************************************************************/
void port_init(void);
void timer_init(void);

/******************************************************************************
* Local Function Definitions
******************************************************************************/
void port_init(void)
{
	DDRA=0xff;
	PORTA = 0x00;
}

void timer_init(void)
{
	TCCR0A = (1<<CS02) | (0<<CS01) | (1<<CS00);
}

/******************************************************************************
* Function:         int main(void)
* Description:      main function
* Input:            
* Output:           
* Notes:            
******************************************************************************/
int main(void)
{
	port_init();
	PORTA = 0x01;
	timer_init();
	
	/* Replace with your application code */
	while(1)
	{
		if((TIFR0 & (1<<TOV0)) == (1<<TOV0))
		{
			TIFR0 = TIFR0 | (1<<TOV0);
			
			if(irany==0)
			{
				PORTA = PORTA << 1;
			}
			else
			{
				PORTA = PORTA >> 1;
			}
		
			if(PORTA==0x80) irany=1;
			if(PORTA==0x01) irany=0;
			
		}
		
		//PORTA = PORTA ^ 0xff;
		//PORTA = PORTA * 2;
		
		
		
		//_delay_ms(50);
		//for(long int i=0;i<100000;i++);
	}
}


/******************************************************************************
* Interrupt Routines
******************************************************************************/





