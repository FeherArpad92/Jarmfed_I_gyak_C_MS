/******************************************************************************
 * Created: 
 * Author :
******************************************************************************/
 /******************************************************************************
* Include files
******************************************************************************/
#include <avr/io.h>
#define F_CPU 8000000UL
#include <util/delay.h>

/******************************************************************************
* Macros
******************************************************************************/


/******************************************************************************
* Constants
******************************************************************************/


/******************************************************************************
* Global Variables
******************************************************************************/
int dir=0;

/******************************************************************************
* External Variables
******************************************************************************/


/******************************************************************************
* Local Function Declarations
******************************************************************************/
void port_init(void);

/******************************************************************************
* Local Function Definitions
******************************************************************************/
/******************************************************************************
* Function:         void port_init(void)
* Description:      I/O portok inicializАlАsa
* Input:
* Output:
* Notes:
******************************************************************************/
void port_init(void)
{
	DDRB = 0xFF;
	//PORTB = 0x01;
	PORTB = 0x01;
}
/******************************************************************************
* Function:         int main(void)
* Description:      main function
* Input:            
* Output:           
* Notes:            
******************************************************************************/
int main(void)
{
	port_init();
	
	/* Replace with your application code */
	while(1)
	{
		if(dir==0)
		{
			PORTB = PORTB << 1;
		}
		else
		{
			PORTB = PORTB >> 1;
		}
		if(PORTB == 0b10000000) dir =1;
		if(PORTB == 0b00000001) dir =0;
		
		//for(long int i=0; i<100000; i++);
		_delay_ms(1000);
	}
}


/******************************************************************************
* Interrupt Routines
******************************************************************************/






