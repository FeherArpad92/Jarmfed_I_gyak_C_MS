/******************************************************************************
 * Created: 
 * Author :
******************************************************************************/
/******************************************************************************
* Include files
******************************************************************************/
#include <avr/io.h>

/******************************************************************************
* Macros
******************************************************************************/


/******************************************************************************
* Constants
******************************************************************************/


/******************************************************************************
* Global Variables
******************************************************************************/
int dir=0;

/******************************************************************************
* External Variables
******************************************************************************/


/******************************************************************************
* Local Function Declarations
******************************************************************************/
void port_init(void);

/******************************************************************************
* Local Function Definitions
******************************************************************************/

/******************************************************************************
* Function:         void port_init(void)
* Description:		port init függvény
* Input:
* Output:
* Notes:			port irányok beállítása
******************************************************************************/
void port_init(void)
{
	DDRA = 0xff;
	PORTA = 1;
		
	DDRB = 0x55;
	PORTB = 0x55;
		
	DDRD = 254;
	PORTD = 254;
}


/******************************************************************************
* Function:         int main(void)
* Description:      main function
* Input:            
* Output:           
* Notes:            
******************************************************************************/
int main(void)
{
	port_init();
	
	/* Replace with your application code */
	while(1)
	{
		if(dir==0)
		{
			PORTA = PORTA << 1;
		}
		else
		{
			PORTA = PORTA >> 1;
		}
		if(PORTA == 0x01) dir = 0;
		if(PORTA == 0x80) dir = 1;
		
		
		
		
		for(long int i = 0; i< 100000;i++);
		
	}
}


/******************************************************************************
* Interrupt Routines
******************************************************************************/






